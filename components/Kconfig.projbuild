## components/mqtt_controller/Kconfig.projbuild
```kconfig
menu "MQTT and ThingsBoard Configuration"

    config PROVISION_KEY
        string "Provision key"
        default "553r8d8nmzy2zdel0wxv"
        help
            Provision key for thingsboard

    config SECRET_KEY
        string "Secret key"
        default "sqmucj3ywvnbdyi0l4ts"
        help
            secret key for thingsboard

endmenu
```

## components/power_manager/Kconfig.projbuild
```kconfig
menu "Power Manager Configuration"

    config PM_ACTIVE_START_HOUR
        string "Start hour for the active range (HH:MM)"
        default "08:00"
        help
            Define the start time since the firmware will start running and wakeup from deep_sleep.
            Format HH:MM
            Range values: 00:00 - 23:59

    config PM_ACTIVE_END_HOUR
        string "End hour for the active range (HH:MM)"
        default "22:00"
        help
            Define the end time since the firmware will stop running and enter deep_sleep mode.
            Format HH:MM
            Range values: 00:00 - 23:59

endmenu
```

## components/wifi/Kconfig.projbuild
```kconfig
menu "WiFi Configuration"

    config ESP_WIFI_SSID
        string "WiFi SSID"
        default "myssid"
        help
            The SSID of the WiFi network.

    config ESP_WIFI_PASSWORD
        string "WiFi Password"
        default "mypassword"
        help
            The password for the WiFi network (WPA2 security).

    config ESP_WIFI_POWER_SAVE
        bool "Enable WiFi Power Save Mode"
        default y
        help
            Enable or disable WiFi Power Save mode to reduce power consumption.

    config ESP_WIFI_MAX_RETRIES
        int "Maximum WiFi Retry Count"
        default 5
        range 1 10
        help
            The number of times the device will attempt to reconnect to WiFi before giving up.

    config ESP_WIFI_LOG_LEVEL
        int "WiFi Debug Log Level"
        default 3
        range 0 5
        help
            The log level for WiFi debugging. 0 = None, 1 = Error, 2 = Warning, 3 = Info, 4 = Debug, 5 = Verbose.

endmenu
```
